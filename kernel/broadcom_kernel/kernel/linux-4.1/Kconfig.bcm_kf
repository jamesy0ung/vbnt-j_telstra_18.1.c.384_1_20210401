## kernel/broadcom_kernel/kernel/linux-4.1/arch/mips/bcm963xx/Kconfig
```kconfig
if MIPS_BCM963XX

choice
	prompt "Built-in device tree"
	help
	  Legacy bootloaders do not pass a DTB pointer to the kernel, so
	  if a "wrapper" is not being used, the kernel will need to include
	  a device tree that matches the target board.

	  The builtin DTB will only be used if the firmware does not supply
	  a valid DTB.

config DT_NONE
	bool "None"

config DT_BCM963268
	bool "BCM963268"
	select BUILTIN_DTB

config DT_BCM96838
	bool "BCM96838"
	select BUILTIN_DTB

endchoice

endif
```
